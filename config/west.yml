## config/west.yml
```yaml
manifest:
  remotes:
    - name: cormoran
      url-base: https://github.com/cormoran
    - name: badjeff    # <-- PMW3610
      url-base: https://github.com/badjeff
    - name: caksoylar  # <-- RGB LED
      url-base: https://github.com/caksoylar
    - name: takamaru-fpv  # <-- Battery level smoothing
      url-base: https://github.com/takamaru-fpv
    - name: urob
      url-base: https://github.com/urob
    - name: kot149  # <-- マウスジェスチャ
      url-base: https://github.com/kot149

  projects:
    # ZMK: DYA Studio 用カスタム RPC サブシステム付き cormoran fork
    - name: zmk
      remote: cormoran
      revision: v0.3-branch+dya
      import: app/west.yml
    - name: zmk-feature-non-lipo-battery-management
      remote: takamaru-fpv
      revision: voltage_division

    # DYA Studio モジュール（すべて cormoran リポジトリ）
    - name: zmk-module-ble-management
      remote: cormoran
      revision: zmk-v0.3.0.0
    - name: zmk-module-battery-history
      remote: cormoran
      revision: main
    - name: zmk-module-settings-rpc
      remote: cormoran
      revision: zmk-v0.3.0.0
    - name: zmk-module-runtime-input-processor
      remote: cormoran
      revision: zmk-v0.3.0.0
    - name: zmk-pmw3610-driver
      remote: badjeff
      revision: zmk-0.3
    - name: zmk-rgbled-widget
      remote: caksoylar
      revision: v0.3-branch
    - name: zmk-unicode
      remote: urob
      revision: v0.3
    # トラックボールの動きの方向でショートカットを送る（左親指4を押している間）。v1 ブランチの 2026-10-19 時点に固定
    - name: zmk-mouse-gesture
      remote: kot149
      revision: 66f905e43cb5d36ef397b26c69c36e7da71dc585
  self:
    path: config
```
