## Kconfig
```kconfig
# CLine46 独自の設定（この設定リポジトリ自体も ZMK のモジュールとして読み込まれる）

config CLINE46_WIN_MODE_FOLLOWS_PROFILE
    bool "Keep the Windows mode layer and Unicode mode in sync with the active BLE profile"
    depends on ZMK_BLE && ZMK_BEHAVIOR_UNICODE
    help
      While the Windows profile is selected, the Windows mode layer stays on and the Unicode input
      mode stays Windows; on other profiles both stay in the Mac setting. This survives reboots
      (deep sleep) and &to, which turns off every layer except the default one.

if CLINE46_WIN_MODE_FOLLOWS_PROFILE

config CLINE46_WIN_PROFILE
    int "BLE profile index of the Windows host"
    default 0

config CLINE46_WIN_MODE_LAYER
    int "Layer id of the Windows mode layer (WIN_MODE in the keymap)"
    default 6

endif

config CLINE46_JIGGLE
    bool "Keep-awake mode: jiggle the mouse cursor by one dot at random intervals"
    depends on ZMK_POINTING
    help
      Adds the &jiggle behavior. While the mode is on, the cursor is moved by one dot in a random
      direction and back every few seconds, unless a key was pressed recently or the auto mouse
      layer is active. The keyboard does not enter deep sleep while the mode is on.

if CLINE46_JIGGLE

config CLINE46_JIGGLE_MIN_INTERVAL_MS
    int "Shortest wait between two jiggles (ms)"
    default 15000

config CLINE46_JIGGLE_MAX_INTERVAL_MS
    int "Longest wait between two jiggles (ms)"
    default 30000

config CLINE46_JIGGLE_TYPING_PAUSE_MS
    int "Do not jiggle for this long after the last key press or release (ms)"
    default 10000

config CLINE46_JIGGLE_AML_LAYER
    int "Layer id of the auto mouse layer (no jiggling while it is active)"
    default 4

config CLINE46_JIGGLE_LED
    bool "Blink the RGB LED widget when the mode changes and on every jiggle"
    default y
    depends on RGBLED_WIDGET

endif
```

## dts/bindings/behaviors/zmk,behavior-cline46-jiggle.yaml
```yaml
# スリープ防止モード（マウスを小刻みに揺らす）のオン・オフを切り替える。中身は src/jiggle.c
description: CLine46 jiggle (keep hosts awake) toggle

compatible: "zmk,behavior-cline46-jiggle"

include: zero_param.yaml
```

## dts/bindings/behaviors/zmk,behavior-cline46-screenshot.yaml
```yaml
# 接続先に合わせてスクリーンショットのショートカットを送る。中身は src/screenshot.c
description: CLine46 screenshot (shortcut depends on the current host)

compatible: "zmk,behavior-cline46-screenshot"

include: zero_param.yaml
```
